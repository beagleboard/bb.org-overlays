/*
 * Copyright (C) 2013 CircuitCo
 *
 * Virtual cape for UART5 on connector pins P9.37 P8.38
 *
 * This program is free software; you can redistribute it and/or modify
 * it under the terms of the GNU General Public License version 2 as
 * published by the Free Software Foundation.
 */
/dts-v1/ /plugin/;

#include <dt-bindings/board/am335x-bbw-bbb-base.h>
#include <dt-bindings/pinctrl/am33xx.h>

/ {
	compatible = "ti,beaglebone", "ti,beaglebone-black", "ti,beaglebone-green";

	// identification
	part-number = "BB-UART5";
	version = "00A0";

	// resources this cape uses
	exclusive-use =
		"P8.37",		// uart5_txd
		"P8.38",		// uart5_rxd

		"uart5";		// hardware ip used


	fragment@0 {
		target = <&am33xx_pinmux>;
		__overlay__ {
			bb_uart5_pins: pinmux_bb_uart5_pins {
				pinctrl-single,pins = <
					BONE_P8_37 (PIN_OUTPUT | MUX_MODE4)	// lcd_data8.uart5_txd
					BONE_P8_38 (PIN_INPUT  | MUX_MODE4)	// lcd_data9.uart5_rxd
				>;
			};
		};
	};

	fragment@1 {
		target = <&uart5>;
		__overlay__ {
			status = "okay";
			pinctrl-names = "default";
			pinctrl-0 = <&bb_uart5_pins>;
		};
	};
};
