/*
* Copyright (C) 2012 Texas Instruments Incorporated - http://www.ti.com/
*
* This program is free software; you can redistribute it and/or modify
* it under the terms of the GNU General Public License version 2 as
* published by the Free Software Foundation.
*/
/dts-v1/;
/plugin/;

#include <dt-bindings/gpio/gpio.h>
#include <dt-bindings/pinctrl/am33xx.h>

/ {
	compatible = "ti,beaglebone", "ti,beaglebone-black", "ti,beaglebone-green";

	/* identification */
	part-number = "BB-BONE-eMMC1-01";
	version = "00A0";

	/* state the resources this cape uses */
	exclusive-use =
		/* the pin header uses */
		"P8.21",	/* mmc1: mmc1_clk */
		"P8.20",	/* mmc1: mmc1_cmd */
		"P8.25",	/* mmc1: mmc1_dat0 */
		"P8.24",	/* mmc1: mmc1_dat1 */
		"P8.5",		/* mmc1: mmc1_dat2 */
		"P8.6",		/* mmc1: mmc1_dat3 */
		"P8.23",	/* mmc1: mmc1_dat4 */
		"P8.22",	/* mmc1: mmc1_dat5 */
		"P8.3",		/* mmc1: mmc1_dat6 */
		"P8.4",		/* mmc1: mmc1_dat7 */
		/* the hardware IP uses */
		"mmc1";

	fragment@0 {
		target = <&am33xx_pinmux>;
		__overlay__ {
			emmc_pins: pinmux_emmc_pins {
				pinctrl-single,pins = <
					AM33XX_IOPAD(0x880, PIN_INPUT_PULLUP | MUX_MODE2) /* gpmc_csn1.mmc1_clk */
					AM33XX_IOPAD(0x884, PIN_INPUT_PULLUP | MUX_MODE2) /* gpmc_csn2.mmc1_cmd */
					AM33XX_IOPAD(0x800, PIN_INPUT_PULLUP | MUX_MODE1) /* gpmc_ad0.mmc1_dat0 */
					AM33XX_IOPAD(0x804, PIN_INPUT_PULLUP | MUX_MODE1) /* gpmc_ad1.mmc1_dat1 */
					AM33XX_IOPAD(0x808, PIN_INPUT_PULLUP | MUX_MODE1) /* gpmc_ad2.mmc1_dat2 */
					AM33XX_IOPAD(0x80c, PIN_INPUT_PULLUP | MUX_MODE1) /* gpmc_ad3.mmc1_dat3 */
					AM33XX_IOPAD(0x810, PIN_INPUT_PULLUP | MUX_MODE1) /* gpmc_ad4.mmc1_dat4 */
					AM33XX_IOPAD(0x814, PIN_INPUT_PULLUP | MUX_MODE1) /* gpmc_ad5.mmc1_dat5 */
					AM33XX_IOPAD(0x818, PIN_INPUT_PULLUP | MUX_MODE1) /* gpmc_ad6.mmc1_dat6 */
					AM33XX_IOPAD(0x81c, PIN_INPUT_PULLUP | MUX_MODE1) /* gpmc_ad7.mmc1_dat7 */
				>;
			};
		};
	};
	fragment@1 {
		target = <&mmc2>;
		__overlay__ {
			vmmc-supply = <&vmmcsd_fixed>;
			pinctrl-names = "default";
			pinctrl-0 = <&emmc_pins>;
			bus-width = <8>;
			status = "okay";
		};
	};
};
