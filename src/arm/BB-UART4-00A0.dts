/*
 * Copyright (C) 2013 CircuitCo
 *
 * Virtual cape for UART4 on connector pins P9.13 P9.11
 *
 * This program is free software; you can redistribute it and/or modify
 * it under the terms of the GNU General Public License version 2 as
 * published by the Free Software Foundation.
 */
/dts-v1/ /plugin/;

#include <dt-bindings/board/am335x-bbw-bbb-base.h>
#include <dt-bindings/pinctrl/am33xx.h>

/ {
	compatible = "ti,beaglebone", "ti,beaglebone-black", "ti,beaglebone-green";

	// identification
	part-number = "BB-UART4";
	version = "00A0";

	// resources this cape uses
	exclusive-use =
		"P9.13",		// uart4_txd
		"P9.11",		// uart4_rxd

		"uart4";		// hardware ip used

	fragment@0 {
		target = <&am33xx_pinmux>;
		__overlay__ {
			bb_uart4_pins: pinmux_bb_uart4_pins {
				pinctrl-single,pins = <
					BONE_P9_13 (PIN_OUTPUT | MUX_MODE6)	// gpmc_wpn.uart4_txd_mux2
					BONE_P9_11 (PIN_INPUT  | MUX_MODE6)	// gpmc_wait0.uart4_rxd_mux2
				>;
			};
		};
	};

	fragment@1 {
		target = <&uart4>;
		__overlay__ {
			status = "okay";
			pinctrl-names = "default";
			pinctrl-0 = <&bb_uart4_pins>;
		};
	};
};
